## CMakeLists.txt
```
# SPDX-License-Identifier: Apache-2.0

cmake_minimum_required(VERSION 3.13.1)
find_package(Zephyr REQUIRED HINTS $ENV{ZEPHYR_BASE})
project(zenoh_app_intree)

# add_subdirectory(external/zenoh-pico)

target_sources(app PRIVATE
  external/zenoh-pico/src/codec.c
  external/zenoh-pico/src/collection.c
  external/zenoh-pico/src/iobuf.c
  external/zenoh-pico/src/utils.c
  external/zenoh-pico/src/net/codec.c
  external/zenoh-pico/src/net/internal.c
  external/zenoh-pico/src/net/lease_task.c
  external/zenoh-pico/src/net/msgcodec.c
  external/zenoh-pico/src/net/property.c
  external/zenoh-pico/src/net/read_task.c
  external/zenoh-pico/src/net/rname.c
  external/zenoh-pico/src/net/session.c
  external/zenoh-pico/src/net/zephyr/network.c
  external/zenoh-pico/src/net/zephyr/system.c
  src/rand.c
  src/strdup.c
  # src/strtof.c
  src/strtok.c
  src/main.c)
target_include_directories(app PRIVATE external/zenoh-pico/include/)
target_compile_definitions(app PRIVATE -DZENOH_ZEPHYR=1)
```

## sample.yaml
```
sample:
  name: External Library
tests:
  sample.app_dev.external_lib:
    tags: external
    harness: console
    harness_config:
      type: multi_line
      regex:
        - "Hello World!"
        - "zenoh_pico says: Hello World!"
```

## prj.conf
```kconfig
CONFIG_STDOUT_CONSOLE=y
CONFIG_PTHREAD_IPC=y
CONFIG_POSIX_API=y
# CONFIG_NET_NATIVE_IPV4=y
CONFIG_NETWORKING=y
CONFIG_NET_IPV4=y
# CONFIG_NET_IF_UNICAST_IPV4_ADDR_COUNT=1
# CONFIG_NET_IF_MCAST_IPV4_ADDR_COUNT=1
# CONFIG_BOARD_OLIMEX_STM32_E407=y
CONFIG_SOC_STM32F407XG=y
```

## src/main.c
```c
/*
 * Copyright (c) 2017 Intel Corporation
 *
 * SPDX-License-Identifier: Apache-2.0
 */

/* hello world example: calling functions from a static library */

#include <zephyr.h>
#include <stdio.h>
#include <unistd.h>
#include <string.h>
// #include <zenoh-pico.h>

int main(int argc, char **argv)
{
    // char *uri = "/demo/example/zenoh-pico-pub";
    // if (argc > 1)
    // {
    //     uri = argv[1];
    // }
    // char *value = "Pub from pico!";
    // if (argc > 2)
    // {
    //     value = argv[2];
    // }

    // zn_properties_t *config = zn_config_default();
    // if (argc > 3)
    // {
    //     zn_properties_insert(config, ZN_CONFIG_PEER_KEY, z_string_make(argv[3]));
    // }

    // printf("Openning session...\n");
    // zn_session_t *s = zn_open(config);
    // if (s == 0)
    // {
    //     printf("Unable to open session!\n");
    //     exit(-1);
    // }

    // // Start the receive and the session lease loop for zenoh-pico
    // znp_start_read_task(s);
    // znp_start_lease_task(s);

    // printf("Declaring Resource '%s'", uri);
    // unsigned long rid = zn_declare_resource(s, zn_rname(uri));
    // printf(" => RId %lu\n", rid);
    // zn_reskey_t reskey = zn_rid(rid);

    // printf("Declaring Publisher on %lu\n", rid);
    // zn_publisher_t *pub = zn_declare_publisher(s, reskey);
    // if (pub == 0)
    // {
    //     printf("Unable to declare publisher.\n");
    //     exit(-1);
    // }

    // char buf[256];
    // for (int idx = 0; 1; ++idx)
    // {
    //     sleep(1);
    //     sprintf(buf, "[%4d] %s", idx, value);
    //     printf("Writing Data ('%lu': '%s')...\n", rid, buf);
    //     zn_write(s, reskey, (const uint8_t *)buf, strlen(buf));
    // }

    // zn_undeclare_publisher(pub);
    // zn_close(s);

    return 0;
}
```

## src/rand.c
```c
/* $Id: rand.c,v 1.1.1.1 2006/08/23 17:03:06 pefo Exp $ */

/*
 * Copyright (c) 2000-2002 Opsycon AB  (www.opsycon.se)
 * 
 * Redistribution and use in source and binary forms, with or without
 * modification, are permitted provided that the following conditions
 * are met:
 * 1. Redistributions of source code must retain the above copyright
 *    notice, this list of conditions and the following disclaimer.
 * 2. Redistributions in binary form must reproduce the above copyright
 *    notice, this list of conditions and the following disclaimer in the
 *    documentation and/or other materials provided with the distribution.
 * 3. All advertising materials mentioning features or use of this software
 *    must display the following acknowledgement:
 *	This product includes software developed by Opsycon AB.
 * 4. The name of the author may not be used to endorse or promote products
 *    derived from this software without specific prior written permission.
 *
 * THIS SOFTWARE IS PROVIDED BY THE AUTHOR ``AS IS'' AND ANY EXPRESS
 * OR IMPLIED WARRANTIES, INCLUDING, BUT NOT LIMITED TO, THE IMPLIED
 * WARRANTIES OF MERCHANTABILITY AND FITNESS FOR A PARTICULAR PURPOSE
 * ARE DISCLAIMED.  IN NO EVENT SHALL THE AUTHOR BE LIABLE FOR ANY
 * DIRECT, INDIRECT, INCIDENTAL, SPECIAL, EXEMPLARY, OR CONSEQUENTIAL
 * DAMAGES (INCLUDING, BUT NOT LIMITED TO, PROCUREMENT OF SUBSTITUTE GOODS
 * OR SERVICES; LOSS OF USE, DATA, OR PROFITS; OR BUSINESS INTERRUPTION)
 * HOWEVER CAUSED AND ON ANY THEORY OF LIABILITY, WHETHER IN CONTRACT, STRICT
 * LIABILITY, OR TORT (INCLUDING NEGLIGENCE OR OTHERWISE) ARISING IN ANY WAY
 * OUT OF THE USE OF THIS SOFTWARE, EVEN IF ADVISED OF THE POSSIBILITY OF
 * SUCH DAMAGE.
 *
 */
#include <stdlib.h>

unsigned long int rand_next = 1;

/*
 *  int rand()
 *      Taken from the K&R C programming language book. Page 46.
 *      returns a pseudo-random integer of 0..32767. Note that
 *      this is compatible with the System V function rand(), not
 *      with the bsd function rand() that returns 0..(2**31)-1.
 */
int 
rand ()
{
	rand_next = rand_next * 1103515245 + 12345;
	return ((unsigned int)(rand_next / 65536) % 32768);
}

/*
 *  srand(seed)
 *      companion routine to rand(). Initializes the seed.
 */
void
srand(unsigned int seed)
{
	rand_next = seed;
}
```

## src/strdup.c
```c
#include <stdlib.h>
#include <string.h>

/**
 *
 * @brief Duplicate a string
 *
 * @return pointer to new string, or NULL if insufficient memory available
 */

char *strdup(const char *s)
{
	char *dest = malloc(strlen(s)+1);

	if (dest) {
		strcpy(dest, s);
	}

	return dest;
}
```

## src/strtof.c
```c
#include <ctype.h>
#include <stdbool.h>

/**
 * Parse the first float found in a char array
 * @param str char array to parse
 * @return the first float detected in the char (e.g. "123.2text" => 123.2F, "text123.2" => 0.0F)
 */
float strtof(const char* str) {
    float res = 0.0F;
    char *ptr = (char*)str;
    bool after_decimal_point = false;
    float div = 1; // Divider to place digits after the deciaml point

    while (*ptr != '\0') {
        if (isdigit((int)*ptr)) {
            // Integer part
            if (!after_decimal_point) {
                res *= 10; // Shift the previous digits to the left
                res += *ptr - '0'; // Add the new one
            }
            // Decimal part
            else {
                div *= 10;
                res += (float)(*ptr - '0') / div;
            }
        }
        else if (*ptr == '.') {
            after_decimal_point = true;
        }
        else {
            break;
        }
        
        ptr++;
    }
    
    return res;
}
```

## src/strtok.c
```c
#include <stddef.h>
#include <stdbool.h>
#include <stdio.h>

bool is_delim(char c, char *delim)
{
  while(*delim != '\0')
  {
    if(c == *delim)
      return true;
    delim++;
  }
  return false;
}

char *strtok(char *s, char *delim)
{
  static char *p; // start of the next search 
  if(!s)
  {
    s = p;
  }
  if(!s)
  {
    // user is bad user 
    return NULL;
  }

  // handle beginning of the string containing delims
  while(1)
  {
    if(is_delim(*s, delim))
    {
      s++;
      continue;
    }
    if(*s == '\0')
    {
      return NULL; // we've reached the end of the string
    }
    // now, we've hit a regular character. Let's exit the
    // loop, and we'd need to give the caller a string
    // that starts here.
    break;
  }

  char *ret = s;
  while(1)
  {
    if(*s == '\0')
    {
      p = s; // next exec will return NULL
      return ret;
    }
    if(is_delim(*s, delim))
    {
      *s = '\0';
      p = s + 1;
      return ret;
    }
    s++;
  }
}
```
